#include <Arduino.h>
#include "filter1.h"
#include "filter2.h"
#include "filter3.h"
#include "filter4.h"
#include "StringSplitter.h"
String zxcv = "";
float zxcv2 = 0;
float zxcv3 = 0;
float zxcv4 = 0;
float zxcv5 = 0;
const double ECG_samplefreq  = 1000;


float datax[10467] = {1.007, 1.313, 1.573, 1.754, 1.840, 1.814, 1.692, 1.506, 1.276, 1.014, 0.752, 0.510, 0.311,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 0.358, 0.631};
float datax_r[2000];
int datax_r_l[2000];
uint32_t iiss = 0;
uint32_t iissdd = 0;

filter1Type *filter = filter1_create();
filter2Type *filter2 = filter2_create();
filter3Type *filter3 = filter3_create();
filter4Type *filter4 = filter4_create();

const int numReadings = 19;

float readings[numReadings];      // the readings from the analog input
int readIndex = 0;              // the index of the current reading
float total = 0;                  // the running total
float average = 0;                // the average

int inputPin = A0;
float averageN = 0;
float averageB = 0;

float averageNN = 0;
float averageNB = 0;

float averageNB_b = 0;

uint32_t timehrx = 0;
uint32_t timehrxB = 0;
uint32_t timehrxC = 0;
uint32_t timehrxD = 0;

uint32_t coundata1000 = 0;
uint32_t coundata2000 = 0;

float Modess = 0;
float Modess_b = 0;

uint32_t time_one_s1 =0;
uint32_t time_one_s2 =0;
uint32_t time_one_s3 =0;
uint32_t time_one_s4 =0;
uint32_t time_one_s5 =0;
uint32_t time_one_s6 =0;
uint32_t time_one_s7 =0;
uint32_t time_one_s8 =0;

uint32_t time_one_st =0;

float  fftsmooth=0;

int st_tttt = 0;
float smooth(float alfa, float new_data, float old_data)
{
  return (old_data + alfa * (new_data - old_data));
}

float modes(int piesAte[], int sizes)
{
  int counter = 1;
  int maxs = 0;
  int modePie = piesAte[0];

  for (int i = 0; i < sizes - 1; i++)
  {
    if (piesAte[i] == piesAte[i + 1])
    {
      counter++;
      if (counter > maxs)
      {
        maxs = counter;
        modePie = piesAte[i];
      }

    }
    else
      counter = 1;

  }

  return modePie;
}

int compare (const void * a, const void * b)
{
  float fa = *(float*) a;
  float fb = *(float*) b;
  return (fa > fb) - (fa < fb);
}

float median1(float array[], int n)
{
  qsort(array, n, sizeof(float), compare);

  if (n % 2 == 0)
    return (array[n / 2] + array[n / 2 - 1]) / 2;
  else
    return array[n / 2];
}
void measureECGAndSend() {

  float value1 = datax[iiss] * 100;
  iiss++;
  if (iiss > 10467 - 1)iiss = 0;

  filter2_filterBlock(filter2,  &value1, &zxcv2, 1 );
  filter1_filterBlock(filter,  &zxcv2, &zxcv3, 1 );
  filter3_filterBlock(filter3,  &zxcv3, &zxcv4, 1 );
  filter4_filterBlock(filter4,  &zxcv4, &zxcv5, 1 );

  total = total - readings[readIndex];
  readings[readIndex] = (uint16_t)zxcv5;
  total = total + readings[readIndex];
  readIndex = readIndex + 1;
  if (readIndex >= numReadings) {
    readIndex = 0;
  }
  average = total / numReadings;
    fftsmooth = smooth(0.02f,average,fftsmooth);
  averageB = averageN;
  averageN = fftsmooth;


//
//  if ((averageN - averageB) > 11 && averageNB < 11) {
//    timehrxB = timehrx;
//    timehrx = millis();
//    Modess_b = Modess;
//    Modess = modes(datax_r_l, coundata1000);
//    //    Serial.println(x2-x1);
//    for(int zxc = 0;zxc<coundata1000;zxc++){
////      if(abs((Modess+2)-datax_r_l[zxc])<2){
////         
////        if(time_one_st == 0){
//////        time_one_s1 = time_one_s2;
//////        time_one_s2 = time_one_s3;
//////        time_one_s3 = time_one_s4;
//////        time_one_s4 = time_one_s5;
//////        time_one_s5 = time_one_s6;
//////        time_one_s6 = time_one_s7;
//////        time_one_s7 = time_one_s8;
////        time_one_s8 = datax_r_l[zxc];
////        }
////        time_one_st =1;
////        
////      }else{
////        time_one_st = 0;
////      }
//      
//      if(zxc%2==0){
//        
////      Serial.print(datax_r_l[time_one_s8]);
////      Serial.print(",");
////      Serial.print(datax_r_l[zxc]);
////      Serial.print(",");
////      Serial.println(Modess+2);
//      }
//    }
//    coundata1000 = 0;
////    coundata2000 = 0;
//  } else {
//      datax_r_l[coundata1000] = fftsmooth;
//      //datax_r[coundata1000] = average;
//      coundata1000 = coundata1000+1;
////    datax_r[coundata2000] = average;
////    coundata2000 = coundata2000 + 1;
//  }



  averageNB_b = averageNB;
  averageNB = (averageN - averageB);
//        if(averageNB>0&&averageNB_b<0){
//    st_tttt =0;
//  }
  if(averageNB<0&&averageNB_b>0){
    if(st_tttt == 0){
      st_tttt = 1;
    }else{
      st_tttt = 0;
    }
    
  }
  iissdd++;
  if (iissdd > 4) {
    float HR = (float)60000 / (timehrx - timehrxB);

//    Serial.print(average/10);
//    Serial.print(",");
    Serial.print(averageNB);
    Serial.print(",");
    Serial.print(average/10);
    Serial.print(",");
    Serial.println(st_tttt);
//Serial.println(averageNB);
    
    iissdd = 0;
  }
  //  Serial.print(",");
  //  Serial.println(value1);
}
void setup() {
  Serial.begin(230400);
  filter1_init(filter);
  filter2_init(filter2);
  filter3_init(filter3);
  filter4_init(filter4);

  iiss = 0;
//  uint32_t x1 = millis();
//  for (int i = 0; i < 1000; i++) {
//    Serial.print("5");
//    delay(2);
//  }
//  Serial.println();
//  //    StringSplitter *splitter = new StringSplitter(Buffer_data, ',',1000);
//  //    int itemCount = splitter->getItemCount();
//  //    delete splitter;
//  uint32_t x2 = millis();
//  Serial.println(x2 - x1);
}

void loop() {
  const static unsigned long ECG_interval  = round(1e6 / ECG_samplefreq);
  static unsigned long ECG_prevmicros = micros();

  if (!Serial) {
    ECG_prevmicros = micros();
  } else if (micros() - ECG_prevmicros >= ECG_interval) {
    measureECGAndSend();
    ECG_prevmicros += ECG_interval;
  }
}
